## conf/machine/beagleboard.conf
```bitbake
#@TYPE: Machine
#@NAME: Beagleboard machine
#@DESCRIPTION: Machine configuration for the http://beagleboard.org/ board 
TARGET_ARCH = "arm"

PREFERRED_PROVIDER_virtual/xserver = "xserver-xorg"
XSERVER = "xserver-xorg \
           xf86-input-evdev \
           xf86-input-mouse \
           xf86-video-omapfb \
           xf86-input-keyboard"

# Only has DVI connector for external screen
GUI_MACHINE_CLASS = "bigscreen"

#include conf/machine/include/tune-arm1136jf-s.inc
# requires gcc 4.3.0:
include conf/machine/include/tune-cortexa8.inc

IMAGE_FSTYPES += "tar.bz2"

# Guesswork
SERIAL_CONSOLE = "115200 ttyS2"

PREFERRED_PROVIDER_virtual/kernel = "linux-omap3"

KERNEL_IMAGETYPE = "uImage"

PREFERRED_PROVIDER_virtual/bootloader = "u-boot-omap3"
UBOOT_ENTRYPOINT = "0x80008000"
UBOOT_LOADADDRESS = "0x80008000"
UBOOT_MACHINE = "omap3_beagle_config"


PREFERRED_VERSION_u-boot = "git"
EXTRA_IMAGEDEPENDS += "u-boot x-load"

MACHINE_EXTRA_RRECOMMENDS = " kernel-modules omap3-sgx-modules "
# and sdio
MACHINE_FEATURES = "kernel26 screen apm usbgadget usbhost vfat alsa"
```

## conf/machine/htckaiser.conf
```bitbake
#@TYPE: Machine
#@NAME: HTC Kaiser phone
#@DESCRIPTION: Machine configuration for HTC Kaiser phone (aka HTC TyTN II)
require conf/machine/include/tune-arm1136-novfp.inc

PREFERRED_PROVIDER_virtual/kernel = "linux-msm7xxxx"

PREFERRED_PROVIDER_virtual/xserver = "xserver-kdrive"
XSERVER = "xserver-kdrive-fbdev"
MACHINE_DISPLAY_WIDTH_PIXELS = "240"
MACHINE_DISPLAY_HEIGHT_PIXELS = "320"

MACHINE_FEATURES = "kernel26 touchscreen screen keyboard phone gps"

IMAGE_FSTYPES += "tar.gz cpio.gz"
```

## conf/machine/htcpolaris.conf
```bitbake
#@TYPE: Machine
#@NAME: HTC Polaris phone
#@DESCRIPTION: Machine configuration for HTC Polaris phone
require conf/machine/include/tune-arm1136-novfp.inc

PREFERRED_PROVIDER_virtual/kernel = "linux-msm7xxxx"

PREFERRED_PROVIDER_virtual/xserver = "xserver-kdrive"
XSERVER = "xserver-kdrive-fbdev"
MACHINE_DISPLAY_WIDTH_PIXELS = "240"
MACHINE_DISPLAY_HEIGHT_PIXELS = "320"

MACHINE_FEATURES = "kernel26 touchscreen screen phone gps"

IMAGE_FSTYPES += "tar.gz cpio.gz"
```

## conf/machine/include/omap3.inc
```bitbake
SOC_FAMILY = "omap3-soc"

require conf/machine/include/tune-cortexa8.inc

# Increase this everytime you change something in the kernel
MACHINE_KERNEL_PR = "r51"

KERNEL_IMAGETYPE = "uImage"

UBOOT_ENTRYPOINT = "0x80008000"
UBOOT_LOADADDRESS = "0x80008000"

# Only build u-boot, xload is optional
EXTRA_IMAGEDEPENDS += "u-boot-omap3"

# TI DVSDK stuff:
# DSPLink rebuild
DSPLINKDSPCFG     ?= "OMAP3530SHMEM"
DSPLINKGPPOS      ?= "OMAPLSP"
DSPLINKPLATFORM   ?= "OMAP3530"
DSPLINKSOC        ?= "3530"


DISTRO_SSH_DAEMON = "openssh-sshd"
```

## conf/machine/overo.conf
```bitbake
#@TYPE: Machine
#@NAME: overo machine
#@DESCRIPTION: Machine configuration for the Gumstix Overo

include conf/machine/include/tune-cortexa8.inc

TARGET_ARCH = "arm"
MACHINE_FEATURES = "kernel26 screen apm usbgadget usbhost vfat alsa"

PREFERRED_VERSION_u-boot-omap3 = "2008.10"
UBOOT_ENTRYPOINT = "0x80008000"
UBOOT_LOADADDRESS = "0x80008000"

PREFERRED_PROVIDER_virtual/kernel = "linux-omap3"
#PREFERRED_VERSION_linux-omap3 = "2.6.27-omap1"

KERNEL_IMAGETYPE = "uImage"
MACHINE_EXTRA_RRECOMMENDS = " kernel-modules"
SERIAL_CONSOLE = "115200 ttyS2"

IMAGE_FSTYPES += "tar.bz2 jffs2"
EXTRA_IMAGECMD_jffs2 = "-lnp "
EXTRA_IMAGEDEPENDS += "u-boot-omap3 x-load"

PREFERRED_PROVIDER_virtual/xserver = "xserver-xorg"
XSERVER = "xserver-xorg \
           xf86-input-evdev \
           xf86-input-mouse \
           xf86-video-fbdev \
           xf86-input-keyboard"

GUI_MACHINE_CLASS = "bigscreen"

ANGSTROM_URI = "http://www.gumstix.net"
```

## contrib/gumstix/build/conf/local.conf
```bitbake
DISTRO = "angstrom-2008.1"

#
# Comment out *one* of the two lines below
DISTRO_TYPE = "debug"
#DISTRO_TYPE = "release"

#
# The default build uses glibc
# Uncomment the line below if you want uclibc instead of glibc
# be prepared for a lot of package breakage!
#ANGSTROM_MODE = "uclibc"

#
# If you enable glibc and encounter qemu-native build issues
# uncomment the line below.
ENABLE_BINARY_LOCALE_GENERATION=0
```
